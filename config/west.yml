## config/west.yml
```yaml
manifest:
  remotes:
    - name: zmkfirmware
      url-base: https://github.com/zmkfirmware
    - name: mouse
      url-base: https://github.com/petejohanson
  projects:
    - name: zmk
      remote: mouse
      revision: core/zephyr-3.5-update
      import: app/west.yml
  self:
    path: config
```
